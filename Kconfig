## Kconfig
```kconfig
# Color definitions to use with color settings
COLOR_BLACK   := 0
COLOR_RED     := 1
COLOR_GREEN   := 2
COLOR_YELLOW  := 3
COLOR_BLUE    := 4
COLOR_MAGENTA := 5
COLOR_CYAN    := 6
COLOR_WHITE   := 7

config RGBLED_WIDGET
    bool "Enable RGB LED widget for showing battery and output status"

if RGBLED_WIDGET


config RGBLED_WIDGET_LED
    bool "Use individual GPIO LEDs for each status type"
    default y
    #auto disable is RGBLED_WIDGET_WS2812 or RGBLED_WIDGET_MONO is on
    depends on !RGBLED_WIDGET_WS2812 && !RGBLED_WIDGET_MONO

config RGBLED_WIDGET_WS2812
    bool "Use WS2812 addressable LEDs instead of GPIO LEDs"
    default n
    help
      Enable WS2812 (NeoPixel) addressable LED support with multi-LED
      capabilities, spatial mapping, animations, and LED sharing.
      When disabled, the original GPIO LED implementation is used.

config RGBLED_WIDGET_MONO
    bool "Use simple mono-color GPIO LEDs"
    default n
    depends on !RGBLED_WIDGET_WS2812
    help
      Enable simple mono-color LED support using individual GPIO pins.
      Supports battery and connectivity status with priority-based sharing.
      GPIOs can be shared between different status types using different
      blink patterns. Priority: CONNECT > BAT > LAYER.

if RGBLED_WIDGET_WS2812

config RGBLED_WIDGET_LED_STRIP_PWM
    bool "Enable PWM instead of SPI"
    default n
# config LED_STRIP
#     default y

# config WS2812_STRIP
#     default y

config RGBLED_WIDGET_LED_COUNT
    int "Number of LEDs in the strip"
    range 1 4
    default 2
    help
      Number of addressable LEDs in the WS2812 strip. Maximum 4 LEDs
      are supported for optimal performance and memory usage.

config RGBLED_WIDGET_SPATIAL_MAPPING
    bool "Enable spatial status mapping"
    default y
    help
      Enable mapping different status types to specific LED positions
      in the strip for clearer visual indication.

config RGBLED_WIDGET_ANIMATIONS
    bool "Enable advanced animations and patterns"
    default y
    help
      Enable advanced LED patterns like pulse, breathing, and smooth
      color transitions for enhanced visual feedback.

config RGBLED_WIDGET_LED_SHARING
    bool "Enable LED sharing for multi-function display"
    default y
    help
      Allow layer indication to temporarily use battery or connectivity LEDs
      when dedicated layer LED is not available or for enhanced visibility.

config RGBLED_WIDGET_STATIC_TIMEOUT_MS
    int "Static display timeout in milliseconds"
    range 100 10000
    default 5000

config RGBLED_WIDGET_SHARE_TIMEOUT_MS
    int "LED sharing timeout in milliseconds"
    range 100 5000
    default 500
    depends on RGBLED_WIDGET_LED_SHARING
    help
      Duration for which a shared LED displays layer status before
      returning to its primary function.

config RGBLED_WIDGET_BATTERY_TIMEOUT_MS
    int "Battery light up timeout in milliseconds"
    range 100 5000
    default 5000


# LED Mapping Configuration
config RGBLED_WIDGET_BATTERY_LED_INDEX
    int "LED index for battery status"
    range 0 3
    default 0
    depends on RGBLED_WIDGET_SPATIAL_MAPPING
    help
      Which LED in the strip displays battery status (0-based index).

config RGBLED_WIDGET_CONN_LED_INDEX
    int "LED index for connectivity status"
    range 0 3
    default 1
    depends on RGBLED_WIDGET_SPATIAL_MAPPING
    help
      Which LED in the strip displays connectivity status (0-based index).

config RGBLED_WIDGET_LAYER_LED_INDEX
    int "LED index for layer status"
    range 0 3
    default 2
    depends on RGBLED_WIDGET_SPATIAL_MAPPING
    help
      Which LED in the strip displays layer status (0-based index).
      If this LED index is >= LED_COUNT, layer sharing will be used.

config RGBLED_WIDGET_LAYER_SHARE_BATTERY
    bool "Allow layer indication to share battery LED"
    default y
    depends on RGBLED_WIDGET_LED_SHARING
    help
      Allow layer changes to temporarily override the battery LED
      when dedicated layer LED is not available.

config RGBLED_WIDGET_LAYER_SHARE_CONN
    bool "Allow layer indication to share connectivity LED"
    default y
    depends on RGBLED_WIDGET_LED_SHARING
    help
      Allow layer changes to temporarily override the connectivity LED
      when dedicated layer LED is not available.

endif # RGBLED_WIDGET_WS2812

if RGBLED_WIDGET_MONO

config RGBLED_WIDGET_MONO_TIMEOUT_MS
    int "Default timeout for mono LED status display (milliseconds)"
    range 1000 30000
    default 5000
    help
      Default timeout in milliseconds for how long mono LEDs stay on
      before automatically turning off to save power.

config RGBLED_WIDGET_MONO_BATTERY_BLINK_MS
    int "Battery status blink duration (milliseconds)"
    range 100 2000
    default 300
    help
      Duration of each blink for battery status indication.

config RGBLED_WIDGET_MONO_CONN_BLINK_MS
    int "Connectivity status blink duration (milliseconds)"
    range 100 2000
    default 200
    help
      Duration of each blink for connectivity status indication.
      Different from battery to distinguish shared GPIO usage.

config RGBLED_WIDGET_MONO_LAYER_BLINK_MS
    int "Layer status blink duration (milliseconds)"
    range 100 2000
    default 400
    help
      Duration of each blink for layer status indication.
      Different from battery/connectivity to distinguish shared GPIO usage.

config RGBLED_WIDGET_MONO_SHARE_TIMEOUT_MS
    int "Shared GPIO timeout (milliseconds)"
    range 100 5000
    default 1000
    help
      How long a higher priority status can use a shared GPIO before
      returning it to the lower priority status.

endif # RGBLED_WIDGET_MONO

# Power Management Configuration
config RGBLED_WIDGET_POWER_MGMT
    bool "Enable RGB LED power management for battery-powered devices"
    default n
    help
      Enable intelligent power management for RGB LEDs that automatically
      controls external power to LEDs based on battery levels and user activity
      patterns. This can provide up to 75% power savings on wireless keyboards.
      Requires boards with external power control capability.

if RGBLED_WIDGET_POWER_MGMT

config RGBLED_WIDGET_POWER_MGMT_BATTERY_THRESHOLD
    int "Battery percentage threshold for power cutoff"
    range 5 95
    default 20
    help
      Battery level percentage below which RGB LEDs will be powered off
      to conserve battery. LEDs will remain off until battery level
      recovers above threshold + hysteresis value.

config RGBLED_WIDGET_POWER_MGMT_IDLE_TIMEOUT_MS
    int "Idle timeout before power off (milliseconds)"
    range 30000 3600000
    default 300000
    help
      Time in milliseconds of keyboard inactivity before RGB LEDs are
      powered off to save battery. LEDs will immediately power on when
      any keyboard activity is detected. Range: 30 seconds to 1 hour.

config RGBLED_WIDGET_POWER_MGMT_HYSTERESIS
    int "Battery hysteresis percentage"
    range 1 20
    default 5
    help
      Hysteresis value added to battery threshold for power-on to prevent
      oscillation around the threshold. LEDs power back on when battery
      level reaches (threshold + hysteresis) percent.

config RGBLED_WIDGET_POWER_MGMT_STARTUP_DELAY_MS
    int "Startup delay before power management becomes active (milliseconds)"
    range 0 10000
    default 2000
    help
      Delay after initialization before power management monitoring begins.
      Allows system to stabilize and prevents premature power-off during
      boot sequence. Set to 0 to disable delay.

config RGBLED_WIDGET_POWER_MGMT_ENABLE_ACTIVITY_DETECTION
    bool "Enable activity-based power management"
    default y
    help
      Enable automatic power-off based on keyboard idle timeout.
      When disabled, only battery-level based power management is active.

config RGBLED_WIDGET_POWER_MGMT_ENABLE_BATTERY_DETECTION
    bool "Enable battery-level based power management"
    default y
    depends on ZMK_BATTERY_REPORTING
    help
      Enable automatic power-off when battery level falls below threshold.
      When disabled, only activity-based power management is active.
      Requires ZMK_BATTERY_REPORTING to be enabled.

config RGBLED_WIDGET_POWER_MGMT_DEBUG
    bool "Enable power management debug logging"
    default n
    help
      Enable detailed debug logging for power management state changes,
      battery monitoring, and activity detection. Useful for troubleshooting
      but may impact performance and power consumption.

endif # RGBLED_WIDGET_POWER_MGMT

config RGBLED_WIDGET_BRIGHTNESS
    int "Default LED brightness (0-255)"
    range 0 255
    default 128
    help
      Default brightness level for WS2812 LEDs. Lower values reduce
      power consumption and eye strain.

config RGBLED_WIDGET_INTERVAL_MS
    int "Minimum wait duration between two blinks in ms"
    default 500

# Battery level settings

choice RGBLED_WIDGET_BATTERY_SHOW
    prompt "Which battery levels to indicate, non-defaults only work for split centrals"

config RGBLED_WIDGET_BATTERY_SHOW_SELF
    bool "Indicate battery level from self only"

config RGBLED_WIDGET_BATTERY_SHOW_PERIPHERALS
    bool "Indicate battery levels from self and peripherals (if split central)"
    depends on (ZMK_SPLIT && ZMK_SPLIT_ROLE_CENTRAL)
    select ZMK_SPLIT_BLE_CENTRAL_BATTERY_LEVEL_FETCHING

config RGBLED_WIDGET_BATTERY_SHOW_ONLY_PERIPHERALS
    bool "Indicate battery levels from peripherals only (if split central)"
    depends on (ZMK_SPLIT && ZMK_SPLIT_ROLE_CENTRAL)
    select ZMK_SPLIT_BLE_CENTRAL_BATTERY_LEVEL_FETCHING

endchoice

config RGBLED_WIDGET_BATTERY_BLINK_MS
    int "Duration of battery level blink in ms"
    default 2000

config RGBLED_WIDGET_BATTERY_LEVEL_HIGH
    int "High battery level percentage"
    default 80

config RGBLED_WIDGET_BATTERY_LEVEL_LOW
    int "Low battery level percentage"
    default 20

config RGBLED_WIDGET_BATTERY_LEVEL_CRITICAL
    int "Critical battery level percentage"
    default 5

config RGBLED_WIDGET_BATTERY_COLOR_HIGH
    int "Color for high battery level (above LEVEL_HIGH)"
    range 0 7
    default $(COLOR_GREEN)

config RGBLED_WIDGET_BATTERY_COLOR_MEDIUM
    int "Color for medium battery level (between LEVEL_LOW and LEVEL_HIGH)"
    range 0 7
    default $(COLOR_YELLOW)

config RGBLED_WIDGET_BATTERY_COLOR_LOW
    int "Color for low battery level (below LEVEL_LOW)"
    range 0 7
    default $(COLOR_RED)

config RGBLED_WIDGET_BATTERY_COLOR_CRITICAL
    int "Color for critical battery level (below LEVEL_CRITICAL)"
    range 0 7
    default $(COLOR_RED)

config RGBLED_WIDGET_BATTERY_COLOR_MISSING
    int "Color for battery not detected, or peripheral disconnected"
    range 0 7
    default $(COLOR_MAGENTA)

# Connectivity indicator settings
config RGBLED_WIDGET_CONN_BLINK_MS
    int "Duration of BLE connection status blink in ms"
    default RGBLED_WIDGET_OUTPUT_BLINK_MS

config RGBLED_WIDGET_CONN_SHOW_USB
    bool "Show USB indicator instead of BLE status if it has priority"

config RGBLED_WIDGET_OUTPUT_BLINK_MS  # DEPRECATED, do not use
    int
    default 1000

config RGBLED_WIDGET_CONN_COLOR_CONNECTED
    int "Color for connected BLE connection status"
    range 0 7
    default $(COLOR_BLUE)

config RGBLED_WIDGET_CONN_COLOR_ADVERTISING
    int "Color for advertising BLE connection status"
    range 0 7
    default $(COLOR_YELLOW)

config RGBLED_WIDGET_CONN_COLOR_DISCONNECTED
    int "Color for disconnected BLE connection status"
    range 0 7
    default $(COLOR_RED)

config RGBLED_WIDGET_CONN_COLOR_USB
    int "Color for USB endpoint active"
    range 0 7
    default $(COLOR_CYAN)

# Layer indicator settings
config RGBLED_WIDGET_SHOW_LAYER_CHANGE
    bool "Indicate highest active layer on each layer change with a sequence of blinks"
config RGBLED_WIDGET_SHOW_BLE_PROFILE
    bool "Indicate ble profile change with a sequence of blinks"

config RGBLED_WIDGET_LAYER_BLINK_MS
    int "Blink and wait duration for layer indicator"
    default 100

config RGBLED_WIDGET_LAYER_COLOR
    int "Color to use for layer indicator"
    range 0 7
    default $(COLOR_CYAN)

config RGBLED_WIDGET_LAYER_DEBOUNCE_MS
    int "Wait duration after a layer change before showing the highest active layer"
    default 100

# Constant layer color settings
config RGBLED_WIDGET_SHOW_LAYER_COLORS
    bool "Use custom colors for layers"

config RGBLED_WIDGET_LAYER_0_COLOR
    int "Color to use for the base layer"
    range 0 7
    default $(COLOR_BLACK)

config RGBLED_WIDGET_LAYER_1_COLOR
    int "Color to use for layer 1"
    range 0 7
    default $(COLOR_RED)

config RGBLED_WIDGET_LAYER_2_COLOR
    int "Color to use for layer 2"
    range 0 7
    default $(COLOR_GREEN)

config RGBLED_WIDGET_LAYER_3_COLOR
    int "Color to use for layer 3"
    range 0 7
    default $(COLOR_YELLOW)

config RGBLED_WIDGET_LAYER_4_COLOR
    int "Color to use for layer 4"
    range 0 7
    default $(COLOR_BLUE)

config RGBLED_WIDGET_LAYER_5_COLOR
    int "Color to use for layer 5"
    range 0 7
    default $(COLOR_MAGENTA)

config RGBLED_WIDGET_LAYER_6_COLOR
    int "Color to use for layer 6"
    range 0 7
    default $(COLOR_CYAN)

config RGBLED_WIDGET_LAYER_7_COLOR
    int "Color to use for layer 7"
    range 0 7
    default $(COLOR_WHITE)

config RGBLED_WIDGET_LAYER_8_COLOR
    int "Color to use for layer 8"
    range 0 7
    default $(COLOR_BLACK)

config RGBLED_WIDGET_LAYER_9_COLOR
    int "Color to use for layer 9"
    range 0 7
    default $(COLOR_BLACK)

config RGBLED_WIDGET_LAYER_10_COLOR
    int "Color to use for layer 10"
    range 0 7
    default $(COLOR_BLACK)

config RGBLED_WIDGET_LAYER_11_COLOR
    int "Color to use for layer 11"
    range 0 7
    default $(COLOR_BLACK)

config RGBLED_WIDGET_LAYER_12_COLOR
    int "Color to use for layer 12"
    range 0 7
    default $(COLOR_BLACK)

config RGBLED_WIDGET_LAYER_13_COLOR
    int "Color to use for layer 13"
    range 0 7
    default $(COLOR_BLACK)

config RGBLED_WIDGET_LAYER_14_COLOR
    int "Color to use for layer 14"
    range 0 7
    default $(COLOR_BLACK)

config RGBLED_WIDGET_LAYER_15_COLOR
    int "Color to use for layer 15"
    range 0 7
    default $(COLOR_BLACK)

config RGBLED_WIDGET_LAYER_16_COLOR
    int "Color to use for layer 16"
    range 0 7
    default $(COLOR_BLACK)

config RGBLED_WIDGET_LAYER_17_COLOR
    int "Color to use for layer 17"
    range 0 7
    default $(COLOR_BLACK)

config RGBLED_WIDGET_LAYER_18_COLOR
    int "Color to use for layer 18"
    range 0 7
    default $(COLOR_BLACK)

config RGBLED_WIDGET_LAYER_19_COLOR
    int "Color to use for layer 19"
    range 0 7
    default $(COLOR_BLACK)

config RGBLED_WIDGET_LAYER_20_COLOR
    int "Color to use for layer 20"
    range 0 7
    default $(COLOR_BLACK)

config RGBLED_WIDGET_LAYER_21_COLOR
    int "Color to use for layer 21"
    range 0 7
    default $(COLOR_BLACK)

config RGBLED_WIDGET_LAYER_22_COLOR
    int "Color to use for layer 22"
    range 0 7
    default $(COLOR_BLACK)

config RGBLED_WIDGET_LAYER_23_COLOR
    int "Color to use for layer 23"
    range 0 7
    default $(COLOR_BLACK)

config RGBLED_WIDGET_LAYER_24_COLOR
    int "Color to use for layer 24"
    range 0 7
    default $(COLOR_BLACK)

config RGBLED_WIDGET_LAYER_25_COLOR
    int "Color to use for layer 25"
    range 0 7
    default $(COLOR_BLACK)

config RGBLED_WIDGET_LAYER_26_COLOR
    int "Color to use for layer 26"
    range 0 7
    default $(COLOR_BLACK)

config RGBLED_WIDGET_LAYER_27_COLOR
    int "Color to use for layer 27"
    range 0 7
    default $(COLOR_BLACK)

config RGBLED_WIDGET_LAYER_28_COLOR
    int "Color to use for layer 28"
    range 0 7
    default $(COLOR_BLACK)

config RGBLED_WIDGET_LAYER_29_COLOR
    int "Color to use for layer 29"
    range 0 7
    default $(COLOR_BLACK)

config RGBLED_WIDGET_LAYER_30_COLOR
    int "Color to use for layer 30"
    range 0 7
    default $(COLOR_BLACK)

config RGBLED_WIDGET_LAYER_31_COLOR
    int "Color to use for layer 31"
    range 0 7
    default $(COLOR_BLACK)

endif # RGBLED_WIDGET

DT_COMPAT_ZMK_BEHAVIOR_RGBLED_WIDGET := zmk,behavior-rgbled-widget

config ZMK_BEHAVIOR_RGBLED_WIDGET
    bool
    default $(dt_compat_enabled,$(DT_COMPAT_ZMK_BEHAVIOR_RGBLED_WIDGET))
```
